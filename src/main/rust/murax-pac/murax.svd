# Murax register map
CPU: VexRiscV 2.0.0, little endian, no MPU, no FPU, 0 interrupt priority bits
Registers are 32-bit, read-write, reset 0x0 unless marked. A register's access mark holds for its fields unless they carry their own. Offsets are from the block's base; lines under a group give offsets from that group; [hi:lo] are bit positions; {n}, {i} and the like mark numbered series; 'fields as' and 'values as' point back to an identical list; <NAME> marks a mode.

## Memory map
0xF0000000 GPIOA size 0xC — General Purpose I/O

## GPIOA — General Purpose I/O
Base 0xF0000000
0x00 INPUT — Digital input
0x04 OUTPUT — Digital output
0x08 DIRECTION — I/O direction
